/*
 * CAUTION: This file is automatically generated by Xilinx.
 * Version: XSCT 
 * Today is: Wed Jan 13 17:22:41 2021
 */


/dts-v1/;
#include "zynq-7000.dtsi"
#include "zynq_Fan_pl.dtsi"
#include "zynq_Fan_ps.dtsi"
#include <dt-bindings/gpio/gpio.h>
/ {

    model = "ZYNQ 7000 Develop Board";
    compatible = "Fan,zynq7000", "xlnx,zynq-7000";

	chosen {
		bootargs = "console=ttyPS0,115200 earlyprintk root=/dev/mmcblk0p2 rw rootwait pl_hdmi.link_freq=150";
		stdout-path = "serial0:115200n8";
	};
	aliases {
		ethernet0 = &gem0;
		i2c0 = &i2c0;
		i2c1 = &rtc_iic;
		i2c2 = &cam1_i2c;
		i2c3 = &cam2_i2c;
		serial0 = &uart1;
		spi0 = &qspi;
		spi1 = &spi1;
	};
	memory {
		device_type = "memory";
		reg = <0x0 0x40000000>;
	};
}; 
